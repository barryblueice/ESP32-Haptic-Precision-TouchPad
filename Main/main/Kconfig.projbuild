## Main/main/Kconfig.projbuild
```kconfig
menu "TouchPad Configuration"

    choice SURFACE_APP_MODE
        prompt "Application entry point"
        default SURFACE_NORMAL_MODE

        config SURFACE_NORMAL_MODE
            bool "Normal touchpad"

        config SURFACE_HAPTIC_TEST_MODE
            bool "CS40L25 haptic firmware/playback test (0x43)"
            help
                Test settings 0,25,63,75,100 with press/release events every 2 seconds.

        config SURFACE_FORCE_UPDATE_MODE
            bool "Force sensor firmware update (0x49)"
            help
                Force a firmware update on every boot, including the same version.
                Print the result and stop without sampling or automatic retry.
                Transfer/checksum errors still stop the operation.

        config SURFACE_SYNAPTICS_UPDATE_MODE
            bool "Synaptics TM3651-001 one-shot firmware update (0x2C)"
            help
                Write the bundled Surface 4.12.139 image on every boot, including
                when the current version matches. Verify the post-reset
                firmware ID, print the result and stop without sampling.
                Only the matching product, BL8 and unchanged layout are supported.

    endchoice

    config SURFACE_FORCE_FORWARD_ENABLE
        bool "Forward six-channel Force samples to Synaptics"
        depends on SURFACE_NORMAL_MODE
        default y
        help
            On fresh Synaptics reports 2/4, read and validate the Force sensor
            C1 frame at 0x49, then forward its six raw channels to 0x2C.
            Paused during sleep, wake and mode changes. No calibration or
            firmware writes. QualifiedKeystroke is zero (no keyboard source).

    menu "USB Descriptor Options"

        config TOUCHPAD_MANUFACTURER_STRING
            string "TouchPad Manufacturer"
            default  "R-SODIUM Technology"

        config TOUCHPAD_PRODUCT_STRING
            string "TouchPad Product String"
            default  "R-SODIUM Haptic TouchPad"

        config TOUCHPAD_SERIAL_NUMBER_STRING
            string "TouchPad Serial Number"
            default  "0D00072C00000000"

        config  TOUCHPAD_HID_INTERFACE_STRING
            string "TouchPad HID Interface"
            default  "Precision Haptic Touchpad HID Interface"
            depends on n

    endmenu

    menu "Receiver Configuration"

        config RECEIVER_MAC_ADDR
            string "Receiver MAC Address"
            default "FF:FF:FF:FF:FF:FF"
            help
                Enter the MAC address of your PTP 2.4G Receiver in XX:XX:XX:XX:XX:XX format.

    endmenu

    menu  "Feature Options"

        choice
            prompt "TouchPad Rotation"
            default TP_ROTATION_LANDSCAPE
            help
            Initial RSTP orientation; saved settings apply to USB, BLE mouse and the paired 2.4G receiver.

        config TP_ROTATION_LANDSCAPE
            bool "Landscape"

        config TP_ROTATION_PORTRAIT
            bool "Portrait"

        config TP_ROTATION_LANDSCAPE_FLIPPED
            bool "Landscape (flipped)"

        config TP_ROTATION_PORTRAIT_FLIPPED
            bool "Portrait (flipped)"

        endchoice

        config TP_ENABLE_SLEEP_MODE
            bool "Enable Sleep Mode"
            default y
            help 
                Initial sleep enable value when no RSTP configuration has been saved.

        config TP_SLEEP_MODE_TIME_MS
            int "Sleep mode timeout value(ms)"
            default 180000
            depends on TP_ENABLE_SLEEP_MODE
            help 
                Initial idle timeout. Saved RSTP configuration overrides this value.
                Values outside 1000..3600000 or not divisible by 1000 use 180000 ms.

        config FUNC_TIMEOUT_MS
            int "Press FUNC key to switch mode timeout (ms)"
            default 3000
            help
                Enter the timeout value for mode switching in milliseconds. When FUNC key is pressed for the certain target duration of time, the device will switch modes after this duration.

        config FUNC_RESET_MS
            int "Press FUNC key to reset mode timeout (ms)"
            default 5000
            help
                Enter the timeout value for mode resetting in milliseconds. When FUNC key is pressed for the certain target duration of time, the device will switch modes into wired mode default. IF FUNC_RESET_MS is bigger than FUNC_TIMEOUT_MS, FUNC_RESET_MS will be FUNC_TIMEOUT_MS + 2000ms by default.

        config LED_FLASH_FUNC_TIMEOUT
            default y
            bool "Led blink when FUNC key is pressed if reaching FUNC_TIMEOUT_MS"
            help
                Enable this option to make the LED blink when FUNC key is pressed and reaches the FUNC_TIMEOUT_MS duration. This can provide a visual indication that the mode switching is about to occur.

        choice
            prompt "Mouse Mode Select"
            default ORI_MOUSE_MODE
            help
            Select the shared mouse implementation for USB, BLE and 2.4G.
            BLE always presents a mouse HID device; PTP simulation runs locally.

        config ORI_MOUSE_MODE
            bool "Original Mouse Mode (Best Compatibility but with basic move only)"

        config PTP_SIMULATED_MOUSE_MODE
            bool "PTP Simulated Mouse Mode (More function but may unstable, experimental function)"

        endchoice

    endmenu

endmenu
```
