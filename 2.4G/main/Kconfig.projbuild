## 2.4G/main/Kconfig.projbuild
```kconfig
menu "TouchPad Configuration"

    menu "USB Descriptor Options"

        config TOUCHPAD_MANUFACTURER_STRING
            string "TouchPad Manufacturer"
            default  "R-SODIUM Technology"

        config TOUCHPAD_PRODUCT_STRING
            string "TouchPad Product String"
            default  "R-SODIUM Haptic 2.4G Receiver"

        config TOUCHPAD_SERIAL_NUMBER_STRING
            string "TouchPad Serial Number"
            default  "0D00072D00000000"

        config  TOUCHPAD_HID_INTERFACE_STRING
            string "TouchPad HID Interface"
            default  "Precision Touchpad HID Interface"
            depends on n

        config LAST_GEN_DESC
            default n
            bool "Using Goodix Descriptor from ESP32 Precision Touchpad for better capability"
            help
                Using Goodix Descriptor from ESP32 Haptic Touchpad for better capability. This setting value will only change legacy ptp descriptor value.

    endmenu

    # menu  "Feature Options"

    # endmenu

endmenu
```
